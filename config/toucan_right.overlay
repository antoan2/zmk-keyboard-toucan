// Local overrides for the right half. ZMK appends this after upstream's
// boards/shields/toucan/toucan_right.overlay, which must stay byte-identical.

// Upstream sets report-rate-lp2 = <640>. The TPS43 reaches LP2 after ~30 s
// without a touch (idle 10 s + LP1 20 s), then samples only every 640 ms:
// the cursor took up to ~1 s to move on the next touch. 160 ms is the chip
// default (~174 uA in LP2 instead of ~55 uA, per upstream's comment).
&tps43_trackpad {
    report-rate-lp2 = <160>;
};
